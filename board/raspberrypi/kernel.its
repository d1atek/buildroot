## board/raspberrypi/kernel.its
```
/dts-v1/;
/ {
    description = "Linux kernel version 6.6.28 (Raspberry Pi 4)";
    images {
        kernel {
            description = "Linux Kernel";
            data = /incbin/("Image"); 
            type = "kernel";
            arch = "arm64"; 
            os = "linux";
            compression = "none";
            load = <0x80000>; 
            entry = <0x80000>;
            hash-1 {
                algo = "sha256"; 
            };
        };
    };
    configurations {
        default = "conf-1";
        conf-1 {
            description = "Boot Linux kernel";
            kernel = "kernel";
        };
    };
};
```
